## Config.in
```kconfig
source "$BR2_EXTERNAL_OCTOPUS_PATH/package/qn8005/Config.in"
source "$BR2_EXTERNAL_OCTOPUS_PATH/package/lvgl/Config.in"
source "$BR2_EXTERNAL_OCTOPUS_PATH/package/wlroots-pixman/Config.in"
source "$BR2_EXTERNAL_OCTOPUS_PATH/package/octopus-wm/Config.in"
source "$BR2_EXTERNAL_OCTOPUS_PATH/package/liboctopus/Config.in"
source "$BR2_EXTERNAL_OCTOPUS_PATH/package/octopus-shell/Config.in"
source "$BR2_EXTERNAL_OCTOPUS_PATH/package/octopus-apps/Config.in"
source "$BR2_EXTERNAL_OCTOPUS_PATH/package/octopus-bundled-apps/Config.in"
source "$BR2_EXTERNAL_OCTOPUS_PATH/package/after-dark-toasters/Config.in"
source "$BR2_EXTERNAL_OCTOPUS_PATH/package/bankstown/Config.in"
```

## package/after-dark-toasters/Config.in
```kconfig
config BR2_PACKAGE_AFTER_DARK_TOASTERS
	bool "after-dark-toasters"
	help
	  The Flying Toasters' pictures (a toaster's four wing frames,
	  a slice of toast), as After Dark CSS has them, for the
	  chumby-toasters screen saver. Downloaded at build time, not
	  kept in this repository: the pictures are (c) 1989 Berkeley
	  Systems.

	  https://www.bryanbraun.com/after-dark-css/
```

## package/bankstown/Config.in
```kconfig
config BR2_PACKAGE_BANKSTOWN
	bool "bankstown"
	depends on BR2_PACKAGE_HOST_RUSTC
	depends on BR2_PACKAGE_LILV
	select BR2_PACKAGE_HOST_CARGO
	help
	  Bankstown — a lightweight psychoacoustic bass enhancement
	  LV2 plugin. Generates 2nd / 3rd harmonics of low-frequency
	  content so small speakers (like the AIY voice bonnet's tiny
	  driver) sound like they have bass response below their
	  physical roll-off.

	  Loaded by PipeWire's filter-chain in
	  /etc/pipewire/pipewire.conf.d/30-rt5645-eq.conf as a node
	  in front of the parametric EQ cascade. Plugin URI:
	  https://chadmed.au/bankstown

	  Source: https://github.com/chadmed/bankstown
```

## package/chumby-apps/Config.in
```kconfig
config BR2_PACKAGE_CHUMBY_APPS
	bool "chumby-apps"
	select BR2_PACKAGE_LIBCHUMBY
	select BR2_PACKAGE_LIBCURL
	select BR2_PACKAGE_MPG123
	select BR2_PACKAGE_FAAD2
	select BR2_PACKAGE_ALSA_LIB
	select BR2_PACKAGE_AFTER_DARK_TOASTERS	# chumby-toasters' pictures
	help
	  The Chumby One's system apps, on libchumby: Clock (with alarms,
	  rung by chumby-shell), FM Radio (uses /usr/bin/radio from the
	  falconwing-mainline board), AirPlay (what shairport-sync
	  receives; the board selects shairport-sync), Settings, and the
	  stream player chumby-stream (MP3 and AAC streams, HLS, files: for
	  any app, through libchumby's chumby_stream_*). And Flying
	  Toasters, the screen saver chumby-shell starts after a while
	  without a touch.

	  Apps that aren't the system's - Internet Radio, Podcasts - are
	  bundles: chumby-bundled-apps.
```

## package/chumby-bundled-apps/Config.in
```kconfig
config BR2_PACKAGE_CHUMBY_BUNDLED_APPS
	bool "chumby-bundled-apps"
	depends on BR2_PACKAGE_CHUMBY_APPS	# chumby-stream plays for them
	select BR2_PACKAGE_LIBCHUMBY
	select BR2_PACKAGE_LIBCURL
	select BR2_PACKAGE_LIBCURL_CURL	# podcast and station art
	select BR2_PACKAGE_EXPAT
	help
	  The apps in apps/ (Internet Radio, Podcasts), built as app
	  bundles - as anyone's, with the SDK (docs/sdk.md) - and
	  preinstalled in the image, read-only, in /usr/lib/chumby/apps.
	  They get no treatment the system apps get: the shell lists them
	  with the bundles installed in /var/apps (one installed there of
	  the same Id replaces the image's: an update).
```

## package/chumby-shell/Config.in
```kconfig
config BR2_PACKAGE_CHUMBY_SHELL
	bool "chumby-shell"
	depends on BR2_PACKAGE_CHUMBY_WM
	select BR2_PACKAGE_LIBCHUMBY
	help
	  The Chumby One system UI: left-edge app switcher with big
	  volume/brightness buttons that open a touch-sized popup, home
	  screen with the installed apps, knob as volume, night-mode
	  backlight and screen-off hours, snooze button, alarm ringing
	  (chumby-alarm-tone). Starts the chumby-wm session at boot
	  (S95chumby-session).
```

## package/chumby-ui/Config.in
```kconfig
config BR2_PACKAGE_CHUMBY_UI
	bool "chumby-ui"
	depends on BR2_TOOLCHAIN_HAS_THREADS # alsa-lib
	select BR2_PACKAGE_ALSA_LIB
	select BR2_PACKAGE_ALSA_LIB_MIXER
	select BR2_PACKAGE_LVGL
	select BR2_PACKAGE_FREETYPE
	select BR2_PACKAGE_FONT_NOTO_SANS
	help
	  LVGL home screen for the Chumby One: clock, FM radio and volume
	  (knob), drawn on the framebuffer with touchscreen input. Text is
	  rendered with FreeType in Noto Sans.
	  Uses /usr/bin/radio (falconwing-mainline board) for the tuner.
```

## package/chumby-wm/Config.in
```kconfig
config BR2_PACKAGE_CHUMBY_WM
	bool "chumby-wm"
	depends on BR2_PACKAGE_WLROOTS_PIXMAN
	help
	  Minimal wlroots compositor for the Chumby One: a left-edge panel
	  ("chumby-panel"), a home layer ("chumby-home") and maximized
	  apps, exported to the shell via wlr-foreign-toplevel-management.

comment "chumby-wm needs wlroots-pixman"
	depends on !BR2_PACKAGE_WLROOTS_PIXMAN
```

## package/font-noto-sans/Config.in
```kconfig
config BR2_PACKAGE_FONT_NOTO_SANS
	bool "font-noto-sans"
	help
	  Noto Sans Regular and Bold (hinted TTF, Latin/Greek/Cyrillic),
	  installed to /usr/share/fonts/noto.

	  https://notofonts.github.io/
```

## package/libchumby/Config.in
```kconfig
config BR2_PACKAGE_LIBCHUMBY
	bool "libchumby"
	depends on BR2_TOOLCHAIN_HAS_THREADS # alsa-lib, wayland
	depends on !BR2_STATIC_LIBS # wayland
	select BR2_PACKAGE_LVGL
	select BR2_PACKAGE_WAYLAND
	select BR2_PACKAGE_WAYLAND_PROTOCOLS
	select BR2_PACKAGE_LIBXKBCOMMON
	select BR2_PACKAGE_ALSA_LIB
	select BR2_PACKAGE_ALSA_LIB_MIXER
	help
	  Common framework for Chumby One apps: LVGL on Wayland, Rockbox's
	  Nimbus bitmap fonts, the universal dark theme with automatic night
	  mode (/etc/chumby/policy.conf), volume/brightness/screen
	  helpers, alarms.
```

## package/liboctopus/Config.in
```kconfig
config BR2_PACKAGE_LIBOCTOPUS
	bool "liboctopus"
	depends on BR2_TOOLCHAIN_HAS_THREADS # alsa-lib, wayland
	depends on !BR2_STATIC_LIBS # wayland
	select BR2_PACKAGE_LVGL
	select BR2_PACKAGE_WAYLAND
	select BR2_PACKAGE_WAYLAND_PROTOCOLS
	select BR2_PACKAGE_LIBXKBCOMMON
	select BR2_PACKAGE_PIXMAN	# the screen saver kit
	select BR2_PACKAGE_ALSA_LIB
	select BR2_PACKAGE_ALSA_LIB_MIXER
	help
	  Common framework for Chumby One apps: LVGL on Wayland, Rockbox's
	  Nimbus bitmap fonts, the universal dark theme with automatic night
	  mode (/etc/octopus/policy.conf), volume/brightness/screen
	  helpers, alarms.
```

## package/librpitx/Config.in
```kconfig
config BR2_PACKAGE_LIBRPITX
	bool "librpitx"
	depends on BR2_arm || BR2_aarch64
	help
	  RF transmission library for the Raspberry Pi: drives the BCM2835/2837
	  clock generator + DMA to emit OOK / FSK / FM / etc. on a GPIO pin
	  with no extra hardware. Provides librpitx.a + headers under
	  /usr/include/librpitx/. Used by rpitx and by onlyfansd.

	  https://github.com/F5OEO/librpitx
```

## package/lvgl/Config.in
```kconfig
config BR2_PACKAGE_LVGL
	bool
	help
	  LVGL graphics library sources (https://lvgl.io), compiled into
	  the apps that select it with their own lv_conf.h.
```

## package/octopus-apps/Config.in
```kconfig
config BR2_PACKAGE_OCTOPUS_APPS
	bool "octopus-apps"
	select BR2_PACKAGE_LIBOCTOPUS
	select BR2_PACKAGE_LIBCURL
	select BR2_PACKAGE_MPG123
	select BR2_PACKAGE_FAAD2
	select BR2_PACKAGE_ALSA_LIB
	select BR2_PACKAGE_AFTER_DARK_TOASTERS	# octopus-toasters' pictures
	help
	  The Chumby One's system apps, on liboctopus: Clock (with alarms,
	  rung by octopus-shell), FM Radio (uses /usr/bin/radio from the
	  falconwing-mainline board), AirPlay (what shairport-sync
	  receives; the board selects shairport-sync), Settings, and the
	  stream player octopus-stream (MP3 and AAC streams, HLS, files: for
	  any app, through liboctopus's octopus_stream_*). And Flying
	  Toasters, the screen saver octopus-shell starts after a while
	  without a touch.

	  Apps that aren't the system's - Internet Radio, Podcasts - are
	  bundles: octopus-bundled-apps.
```

## package/octopus-bundled-apps/Config.in
```kconfig
config BR2_PACKAGE_OCTOPUS_BUNDLED_APPS
	bool "octopus-bundled-apps"
	depends on BR2_PACKAGE_OCTOPUS_APPS	# octopus-stream plays for them
	select BR2_PACKAGE_LIBOCTOPUS
	select BR2_PACKAGE_LIBCURL
	select BR2_PACKAGE_LIBCURL_CURL	# podcast and station art
	select BR2_PACKAGE_EXPAT
	help
	  The apps in apps/ (Internet Radio, Podcasts), built as app
	  bundles - as anyone's, with the SDK (docs/sdk.md) - and
	  preinstalled in the image, read-only, in /usr/lib/octopus/apps.
	  They get no treatment the system apps get: the shell lists them
	  with the bundles installed in /var/apps (one installed there of
	  the same Id replaces the image's: an update).
```

## package/octopus-shell/Config.in
```kconfig
config BR2_PACKAGE_OCTOPUS_SHELL
	bool "octopus-shell"
	depends on BR2_PACKAGE_OCTOPUS_WM
	select BR2_PACKAGE_LIBOCTOPUS
	help
	  The Chumby One system UI: left-edge app switcher with big
	  volume/brightness buttons that open a touch-sized popup, home
	  screen with the installed apps, knob as volume, night-mode
	  backlight and screen-off hours, snooze button, alarm ringing
	  (octopus-alarm-tone). Starts the octopus-wm session at boot
	  (S95octopus-session).
```

## package/octopus-wm/Config.in
```kconfig
config BR2_PACKAGE_OCTOPUS_WM
	bool "octopus-wm"
	depends on BR2_PACKAGE_WLROOTS_PIXMAN
	help
	  Minimal wlroots compositor for the Chumby One: a left-edge panel
	  ("octopus-panel"), a home layer ("octopus-home") and maximized
	  apps, exported to the shell via wlr-foreign-toplevel-management.

comment "octopus-wm needs wlroots-pixman"
	depends on !BR2_PACKAGE_WLROOTS_PIXMAN
```

## package/onlyfansd/Config.in
```kconfig
config BR2_PACKAGE_ONLYFANSD
	bool "onlyfansd"
	depends on BR2_PACKAGE_HOST_RUSTC
	depends on BR2_PACKAGE_LIBRPITX
	select BR2_PACKAGE_HOST_CARGO
	help
	  HomeKit / Home Assistant bridge for Casa Vieja TR301A ceiling fans.
	  Transmits the 25-bit OOK frame on 304.30 MHz directly via librpitx
	  (no `sendook` shell-out — librpitx is linked in).

	  Source is vendored at $(BR2_EXTERNAL_PIFANSRF_PATH)/onlyfansd.
```

## package/qn8005/Config.in
```kconfig
config BR2_PACKAGE_QN8005
	bool "qn8005"
	help
	  Userland control for the Quintic QN8005 FM tuner in the Chumby
	  One (init, tune, mute, scan, register access) over i2c-dev.
	  Register sequences follow Chumby's stock fmradio tool.
```
